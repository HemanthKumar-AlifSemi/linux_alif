## Documentation/devicetree/bindings/arm/alif/alif.yaml
```yaml
# SPDX-License-Identifier: (GPL-2.0-only OR BSD-2-Clause)
%YAML 1.2
---
$id: http://devicetree.org/schemas/arm/alif/alif.yaml#
$schema: http://devicetree.org/meta-schemas/core.yaml#

title: Alif Semiconductor Ensemble SoC based Platforms

maintainers:
  - Hemanth Kumar <hemanth@alifsemi.com>

description: |
  Boards and devices based on Alif Semiconductor Ensemble SoC family.

  The Alif Ensemble family includes:
  - Ensemble E6: Single Cortex-A32 core
  - Ensemble E8: Dual Cortex-A32 cores

  Development platforms:
  - DevKit: Devkit boards for E6 (unicore) and E8 (dual-core)
  - AppKit: Appkit boards for E6 (unicore) and E8 (dual-core)

properties:
  $nodename:
    const: '/'

  compatible:
    const: alif,ensemble

additionalProperties: true
```

## Documentation/devicetree/bindings/counter/alif,alif-utimer.yaml
```yaml
# SPDX-License-Identifier: (GPL-2.0 OR BSD-2-Clause)
%YAML 1.2
---
$id: http://devicetree.org/schemas/counter/alif,alif-utimer.yaml#
$schema: http://devicetree.org/meta-schemas/core.yaml#

title: Alif Microcontroller UTIMER (Unified Timer) Module

maintainers:
  - Hemanth Kumar <hemanth@alifsemi.com>

description: |
  The Alif UTIMER is a unified timer/counter module with multiple channels,
  each supporting independent start/stop/clear controls and interrupt generation.

properties:
  compatible:
    const: alif,alif-utimer

  reg:
    maxItems: 1
    description: |
      Physical base address and size of the UTIMER register set.

  interrupts:
    minItems: 1
    maxItems: 64
    description: |
      List of interrupts, one per timer channel, in ascending order (e.g.,
      Channel 0 = interrupts[0], Channel 1 = interrupts[1], etc.).

  clocks:
    maxItems: 1
    description: |
      AXI clock phandle for the timer module.

  clock-names:
    const: axi_clk

  "#pwm-cells":
    const: 0
    description: |
      If the timer supports PWM mode, this property may be present.

required:
  - compatible
  - reg
  - interrupts
  - interrupt-parent
  - clocks
  - clock-names

additionalProperties: false

examples:
  - |
    #include <dt-bindings/interrupt-controller/arm-gic.h>
    #include <dt-bindings/clock/alif-clock.h>

    ahb-bus@48100000 {
      compatible = "simple-bus";
      #address-cells = <1>;
      #size-cells = <1>;
      ranges = <0x48000000 0x48100000 0x100000>;

      utimer: timer@48000000 {
        compatible = "alif,alif-utimer";
        reg = <0x48000000 0x100000>;
        interrupt-parent = <&gic>;
        interrupts = <GIC_SPI 366 IRQ_TYPE_EDGE_RISING>,
                     <GIC_SPI 367 IRQ_TYPE_EDGE_RISING>,
                     /* ... (all 64 interrupts) ... */
                     <GIC_SPI 461 IRQ_TYPE_EDGE_RISING>;
        clocks = <&psclks ENSEMBLE_SYST_ACLK>;
        clock-names = "axi_clk";
        status = "okay";
      };
    };
```

## Documentation/devicetree/bindings/cpufreq/alif,ensemble-cpufreq.yaml
```yaml
# SPDX-License-Identifier: (GPL-2.0-only OR BSD-2-Clause)
%YAML 1.2
---
$id: http://devicetree.org/schemas/cpufreq/alif,ensemble-cpufreq.yaml#
$schema: http://devicetree.org/meta-schemas/core.yaml#

title: Alif Ensemble SoC CPUFreq Driver

maintainers:
  - Pankaj Pandey <pankaj.pandey@alifsemi.com>

description: |
  The Alif Ensemble CPUFreq driver provides dynamic CPU frequency scaling.
  The driver supports frequency scaling from 800 MHz down to 25 MHz using a
  programmable clock divider.

  The driver integrates with the Linux clock framework and uses the
  HOSTCPUCLK_DIV1 register to control the CPU clock divider. It supports 32
  discrete frequency steps derived from the 800 MHz PLL clock source.

  The driver internally accesses the CPU clock through the clock framework
  using exported functions from the clock driver (ensemble_cpu_clk_set_rate
  and ensemble_cpu_clk_get_rate).

properties:
  compatible:
    const: alif,ensemble-cpufreq

  clock-frequency:
    description: |
      Initial CPU clock frequency in Hz. This is used as the boot default
      frequency when the driver initializes. Must match the actual hardware
      boot frequency configured by the bootloader or firmware.

required:
  - compatible
  - clock-frequency

additionalProperties: false

examples:
  - |
    // CPUFreq device node with clock-frequency
    ensemble_cpufreq: cpufreq {
        compatible = "alif,ensemble-cpufreq";
        clock-frequency = <800000000>;  /* 800 MHz boot default */
        status = "disabled";
    };
```

## Documentation/devicetree/bindings/crypto/alif,alif-crccode.yaml
```yaml
# SPDX-License-Identifier: (GPL-2.0 OR BSD-2-Clause)
%YAML 1.2
---
$id: http://devicetree.org/schemas/crypto/alif,alif-crccode.yaml#
$schema: http://devicetree.org/meta-schemas/core.yaml#

title: Alif Ensemble CRC Controller

maintainers:
  - Hemanth Kumar <hemanth@alifsemi.com>

description: |
  The Alif Ensemble CRC controller is a hardware-based cyclic redundancy
  check (CRC) computation unit.

properties:
  compatible:
    const: alif,alif-crccode
    description: Should be "alif,alif-crccode".

  reg:
    maxItems: 1
    description: The address and length of the CRC peripheral registers.

  clocks:
    maxItems: 1
    description: Phandle to the input clock of the CRC instance.

  clock-names:
    const: ahb_clk
    description: Name of the CRC clock.

required:
  - compatible
  - reg
  - clocks
  - clock-names

additionalProperties: false

examples:
  - |
    crc@48107000 {
      compatible = "alif,alif-crccode";
      reg = <0x48107000 0x1000>;
      clocks = <&syst_hclk>;
      clock-names = "ahb_clk";
    };
```

## Documentation/devicetree/bindings/dma/alif,event-router.yaml
```yaml
# SPDX-License-Identifier: (GPL-2.0 OR BSD-2-Clause)
%YAML 1.2
---
$id: http://devicetree.org/schemas/dma/alif,event-router.yaml#
$schema: http://devicetree.org/meta-schemas/core.yaml#

title: ALIF Event Router DMA Controller

maintainers:
  - Aravind Krishnan <aravind.krishnan@alifsemi.com>

description: |
  The ALIF Event Router is a 4:1 multiplexer that routes DMA events from peripherals
  to the DMA controller. It supports 32 DMA channels, with each channel capable
  of being connected to one of 4 peripherals.

properties:
  compatible:
    const: alif,event-router

  reg:
    maxItems: 1
    description: |
      Memory mapped register range for the event router configuration

  "#dma-cells":
    const: 2
    description: |
      First cell is the DMA channel number (0-31)
      Second cell is the peripheral source (0-3)

  dma-masters:
    $ref: /schemas/types.yaml#/definitions/phandle
    description: |
      Phandle to the DMA controller (e.g., PL330) that this router feeds

required:
  - compatible
  - reg
  - "#dma-cells"
  - dma-masters

additionalProperties: false

examples:
  - |
    event_router: dma-router@40000000 {
        compatible = "alif,event-router";
        reg = <0x40000000 0x1000>;
        #dma-cells = <2>;
        dma-masters = <&dma0>;
    };
```

## Documentation/devicetree/bindings/iio/adc/alif,adc.yaml
```yaml
# SPDX-License-Identifier: (GPL-2.0-only OR BSD-2-Clause)
%YAML 1.2
---
$id: "http://devicetree.org/schemas/iio/adc/alif,adc.yaml#"
$schema: "http://devicetree.org/meta-schemas/core.yaml#"

title: Alif Ensemble ADC12/ADC24 Controller

maintainers:
  - name: Pankaj Pandey
    email: pankaj.pandey@alifsemi.com

description: |
  The Alif Ensemble platform integrates multiple ADC controllers:
  - ADC12 instances (12-bit ADC, multiple channels, multiple interrupts)
  - ADC24 instance (24-bit ADC, multiple interrupts)

  Each ADC block supports a set of interrupts and requires an
  associated functional clock.

properties:
  compatible:
    enum:
      - alif,adc-dev

  reg:
    maxItems: 1
    description: Register base and size of the ADC instance.

  reg-names:
    const: adc_base

  interrupt-parent:
    description: Parent interrupt controller (usually GIC).

  interrupts:
    minItems: 1
    maxItems: 4
    description: |
      Four interrupts per ADC instance, ordered as documented in TRM:
      - End-of-conversion
      - FIFO threshold
      - Overflow
      - Error

  clocks:
    maxItems: 1
    description: Reference clock for ADC controller.

  clock-names:
    const: adc_clk

  status:
    enum: [ "okay", "disabled" ]

required:
  - compatible
  - reg
  - reg-names
  - interrupts
  - clocks
  - clock-names

additionalProperties: false

examples:
  - |
    adc0: adc12_0@49020000 {
        compatible = "alif,adc-dev";
        reg = <0x49020000 0x100>;
        reg-names = "adc_base";
        interrupt-parent = <&gic>;
        interrupts = <0 140 IRQ_TYPE_LEVEL_HIGH>,
                     <0 143 IRQ_TYPE_LEVEL_HIGH>,
                     <0 146 IRQ_TYPE_LEVEL_HIGH>,
                     <0 149 IRQ_TYPE_LEVEL_HIGH>;
        clocks = <&psclks ENSEMBLE_ADC120_CLK>;
        clock-names = "adc_clk";
        status = "disabled";
    };

    adc24: adc24@49027000 {
        compatible = "alif,adc-dev";
        reg = <0x49027000 0x100>;
        reg-names = "adc_base";
        interrupt-parent = <&gic>;
        interrupts = <0 152 IRQ_TYPE_LEVEL_HIGH>,
                     <0 153 IRQ_TYPE_LEVEL_HIGH>,
                     <0 154 IRQ_TYPE_LEVEL_HIGH>,
                     <0 155 IRQ_TYPE_LEVEL_HIGH>;
        clocks = <&psclks ENSEMBLE_ADC24_CLK>;
        clock-names = "adc_clk";
        status = "disabled";
    };
```

## Documentation/devicetree/bindings/iio/dac/alif,ensemble-dac.yaml
```yaml
# SPDX-License-Identifier: GPL-2.0-only OR BSD-2-Clause
%YAML 1.2
---
$id: "http://devicetree.org/schemas/iio/dac/alif,ensemble-dac.yaml#"
$schema: "http://devicetree.org/meta-schemas/core.yaml#"

title: ALIF Ensemble DAC

description: |
  Schema for the DAC (Digital-to-Analog Converter) nodes found on the ALIF ENSEMBLE SoC.

maintainers:
  - Hemanth Kumar <hemanth@alifsemi.com>

properties:
  compatible:
    const: alif,ensemble-dac

  reg:
    description: Address and length of the device's register set.
    items:
      - description: Base address of the DAC register set.
      - description: Size of the DAC register set.

  clocks:
    $ref: /schemas/types.yaml#/definitions/phandle-array
    description: Handle to the input clock for the DAC.


  clock-names:
    description: List of input clocks.
    items:
      - const: apb_pclk

  status:
    description: Device status.
    enum:
      - "okay"
      - "disabled"

required:
  - compatible
  - reg
  - clocks
  - clock-names

additionalProperties: false

examples:
  - |
    #include <dt-bindings/clock/alif,ensemble-clock.h>

    dac0: dac12_0@49028000 {
        compatible = "alif,ensemble-dac";
        reg = <0x49028000 0x10>;
        clocks = <&syst_pclk 0>;
        clock-names = "apb_pclk";
        status = "disabled";
    };

    dac1: dac12_1@49029000 {
        compatible = "alif,ensemble-dac";
        reg = <0x49029000 0x10>;
        clocks = <&syst_pclk 0>;
        clock-names = "apb_pclk";
        status = "disabled";
    };
```

## Documentation/devicetree/bindings/misc/alif,cmp-module.yaml
```yaml
# SPDX-License-Identifier: (GPL-2.0-only OR BSD-2-Clause)
%YAML 1.2
---
$id: http://devicetree.org/schemas/misc/alif,cmp-module.yaml#
$schema: http://devicetree.org/meta-schemas/core.yaml#

title: ALIF High-Speed Comparator (CMP) Device Tree Bindings

maintainers:
  - Pankaj Pandey <pankaj.pandey@alifsemi.com>

description: |
  The ALIF High-Speed Comparator is an analog comparator with programmable
  reference voltage and hysteresis. This device tree binding defines how it
  should be described in the devicetree.

allOf:
  - if:
      properties:
        compatible:
          contains:
            const: alif,cmp-module
    then:
      required:
	- compatible
	- reg
	- reg-names
	- interrupts
	- interrupt-parent
	- clocks
	- cmp-gpios
	- led-gpios (only for cmp0)
	- instance
	- status

properties:
  compatible:
    const: alif,cmp-module

  reg:
    minItems: 2
    maxItems: 2
    type: reg
    description: |
      The first region is the module's register space.
      The second region is the base address space.

  reg-names:
    items:
      - const: cmp_reg

  interrupts:
    maxItems: 1
    type: interrupts
    description: Interrupt for the comparison module

  interrupt-parent:
    type: interrupt-controller
    description: phandle to the interrupt controller

  clocks:
    maxItems: 1
    type: phandle
    description: Clock for the comparison module

  cmp-gpios:
    maxItems: 1
    type: phandle-array
    description: GPIO used for comparison output

  led-gpios:
    maxItems: 1
    type: phandle-array
    description: GPIO for status LED indication required for CMP0, rest will share.

  instance:
    minimum: 0
    maximum: 3
    type: int
    description: CMP instance ID (0 = CMP0, 1 = CMP1, etc.)

  status:
    description: Initial module status
    $ref: /schemas/types.yaml#/definitions/string
    enum: [ "disabled", "okay" ]
    default: "disabled"

additionalProperties: false

examples:
  - |
    cmp0: cmp0@49023000 {
        compatible = "alif,cmp-module";
        reg = <0x49023000 0x1000>;
        reg-names = "cmp_reg";
        interrupt-parent = <&gic>;
        interrupts = <GIC_SPI 156 IRQ_TYPE_LEVEL_HIGH>;
        clocks = <&psclks ENSEMBLE_CMP0_CLK>;
        cmp-gpios = <&port15 7 GPIO_ACTIVE_HIGH>;
        led-gpios = <&port13 3 GPIO_ACTIVE_HIGH>;
	instance = <0>;
        status = "disabled";
    };

    cmp1: cmp1@49024000 {
        compatible = "alif,cmp-module";
        reg = <0x49024000 0x1000>;
        reg-names = "cmp_reg";
        interrupt-parent = <&gic>;
        interrupts = <GIC_SPI 157 IRQ_TYPE_LEVEL_HIGH>;
        clocks = <&psclks ENSEMBLE_CMP0_CLK>;
        cmp-gpios = <&port15 6 GPIO_ACTIVE_HIGH>;
	instance = <1>;
        status = "disabled";
    };
...
```

## Documentation/devicetree/bindings/mmc/alif,sdhci-alif-reset.yaml
```yaml
# SPDX-License-Identifier: (GPL-2.0-only OR BSD-2-Clause)
%YAML 1.2
---
$id: http://devicetree.org/schemas/bindings/mmc/ensemble,sd-reset.yaml#
$schema: http://devicetree.org/meta-schemas/core.yaml#

title: Ensemble SD Controller Reset and Card Detect Binding

maintainers:
  - Pankaj Pandey <pankaj.pandey@alifsemi.com>

description: |
  This binding describes a custom node used to control the reset and card detect
  lines for an SD/MMC controller on the Ensemble devkit platform.

properties:
  compatible:
    const: ensemble,sd-reset

  reset-gpios:
    maxItems: 1
    description: |
      GPIO specifier for the reset pin connected to the SD/MMC controller.
      Should contain a phandle and GPIO specifier per the GPIO binding.

required:
  - compatible
  - reset-gpios

examples:
  - |
    sd_reset: sd-reset {
        compatible = "alif,sd-reset";
        reset-gpios = <&port15 7 GPIO_ACTIVE_HIGH>;
    };
```
