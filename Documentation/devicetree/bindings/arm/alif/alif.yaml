## Documentation/devicetree/bindings/regulator/alif,ensemble-regulator.yaml
```yaml
# SPDX-License-Identifier: (GPL-2.0-only OR BSD-2-Clause)
%YAML 1.2
---
$id: http://devicetree.org/schemas/regulator/alif,ensemble-regulator.yaml#
$schema: http://devicetree.org/meta-schemas/core.yaml#

title: Alif Semiconductor Ensemble soc on-chip Regulator

maintainers:
  - Aravind Krishnan M <aravind.krishnan@alifsemi.com>

description: |
  This binding describes the voltage regulator present on the
  Ensemble SoC by Alif Semiconductor.
  The regulator supports two voltage levels (3.3V and 1.8V) and can be controlled
  via a single register bit.

properties:
  compatible:
    const: alif,ensemble-regulator
    description: Identifies the regulator as an Alif Semiconductor Ensemble regulator.

  reg:
    maxItems: 1
    description: Base address and size of the register region used to control the regulator.

  regulator-name:
    description: Name of the regulator. This is optional and defaults to "ensemble_flexio".

  regulator-min-microvolt:
    description: Minimum voltage supported by the regulator in microvolts.
    default: 1800000

  regulator-max-microvolt:
    description: Maximum voltage supported by the regulator in microvolts.
    default: 3300000

  regulator-initial-mode:
    description: |
      This determines the initial voltage setting of the regulator.
      "ensemble_flexio" regulator supports two modes.
      REGULATOR_MODE_NORMAL
      REGULATOR_MODE_IDLE.
      3.3v and 1.8v respectively.

  regulator-always-on:
    type: boolean
    description: Indicates whether the regulator should always remain on.

required:
  - compatible
  - reg
  - regulator-initial-mode
  - regulator-always-on

additionalProperties: false

examples:

  - |
    # Example device tree node for the Ensemble regulator
    ensemble_reg: regulator@1a609000 {
        compatible = "alif,ensemble-regulator";
        reg = <0x1a609000 0x4>;
        flexio_reg: ensemble_flexio {
                regulator-name = "ensemble_flexio";
                regulator-min-microvolt = <1800000>;
                regulator-max-microvolt = <3300000>;
                regulator-initial-mode = <0x4>; /*REGULATOR_MODE_IDLE*/
                regulator-always-on;
        };
    };

...
```

## Documentation/devicetree/bindings/rpmsg/alif,mhu-client.yaml
```yaml
# SPDX-License-Identifier: (GPL-2.0 OR BSD-2-Clause)
$id: "http://devicetree.org/schemas/hwlock/alif,rpmsg.yaml#"
$schema: "http://devicetree.org/meta-schemas/core.yaml#"

title: ARM MHUv2 RPMSG mailbox Client
description: ARM MHUv2 RPMSG mailbox Client

maintainers:
  - Hemanth.Kumar<hemanth@alifsemi.com>

properties:
  compatible:
    enum:
      - alif,client

  mbox:
    description: |
      List of phandles to mailbox channels used for receiving and
      transmitting data from and to the hardware UART.
    items:
      - description: mailbox for receiving data from hardware UART
      - description: mailbox for transmitting data to hardware UART

   mbox-names:
    items:
      - const: txdb
      - const: rxdb


required:
  - compatible
  - mbox-names
  - mboxes

additionalProperties: false

examples:
  - |
    client {
	compatible = "arm,client";
        mbox-names = 	"txdb0", "txdb1",
			"rxdb0", "rxdb1",
			"txdb2", "txdb3",
			"rxdb2", "rxdb2",
			"txdb4", "txdb5",
			"rxdb4", "rxdb5";
	mboxes 	   =	<&mbox_m55_hp_mhu0_tx 0 0>,
			<&mbox_m55_hp_mhu1_tx 0 0>,
			<&mbox_m55_hp_mhu0_rx 0 0>,
			<&mbox_m55_hp_mhu1_rx 0 0>,
			<&mbox_m55_he_mhu0_tx 0 0>,
			<&mbox_m55_he_mhu1_tx 0 0>,
			<&mbox_m55_he_mhu0_rx 0 0>,
			<&mbox_m55_he_mhu1_rx 0 0>,
			<&mbox_se_mhu0_tx 0 0>,
			<&mbox_se_mhu1_tx 0 0>,
			<&mbox_se_mhu0_rx 0 0>,
			<&mbox_se_mhu1_rx 0 0>;
    };
```

## Documentation/devicetree/bindings/rtc/snps,designware-rtc.yaml
```yaml
# SPDX-License-Identifier: (GPL-2.0-only OR BSD-2-Clause)

%YAML 1.2

---

$id: "http://devicetree.org/schemas/rtc/snps,designware-rtc.yaml#"

$schema: "http://devicetree.org/meta-schemas/core.yaml#"

title: Alif Ensemble Real Time Counter (RTC)

maintainers:
  - Hemanth Kumar <hemanth@alifsemi.com>

description: |
  Real Time Counter IP for the Alif Ensemble platform.

properties:
  compatible:
    const: "snps,designware-rtc"

  reg:
    maxItems: 1
    description: >
      Physical base address and length of the memory-mapped region for the RTC.

  interrupts:
    maxItems: 1
    description: >
      Interrupt line for the RTC.

  clocks:
    items:
      - description: Low-power Real Time Counter clock (lprtc_clk)
      - description: Peripheral clock (pclk)

    description: |
      Phandles to the clocks used by the RTC.

  clock-names:
    items:
      - const: "lprtc_clk"
      - const: "pclk"

required:
  - compatible
  - reg
  - interrupts
  - clocks
  - clock-names

additionalProperties: false

examples:

  - |
    rtc: rtc@42000000 {
      compatible = "snps,designware-rtc";
      reg = <0x42000000 0x100>;
      interrupts = <GIC_SPI 339 IRQ_TYPE_LEVEL_HIGH>;
      clocks = <&psclks ENSEMBLE_S32K_CLK>,
               <&psclks ENSEMBLE_SYST_PCLK>;
      clock-names = "lprtc_clk", "pclk";
    };
```

## Documentation/devicetree/bindings/sound/alif,alif-pcm-card.yaml
```yaml
# SPDX-License-Identifier: (GPL-2.0 OR BSD-2-Clause)
$id: "http://devicetree.org/schemas/sound/alif,alif-pcm-card.yaml#"
$schema: "http://devicetree.org/meta-schemas/core.yaml#"

title: Alif Ensemble SoC Sound Card

description: |
  Binding for the Alif Ensemble SoC Sound Card.

maintainers:
  - Hemanth Kumar <hemanth@alifsemi.com>

properties:
  compatible:
    const: alif,alif-pcm-card

  clocks:
    maxItems: 1
    description: Input clock specifier. Should be <&syst_pclk 0>.

required:
  - compatible
  - clocks

additionalProperties: false

examples:
  - |
    pcmcard: pcmcard@4902D800 {
      compatible = "alif,alif-pcm-card";
      clocks = <&syst_pclk 0>;
    };
```

## Documentation/devicetree/bindings/sound/alif,alif-pcm.yaml
```yaml
# SPDX-License-Identifier: (GPL-2.0 OR BSD-2-Clause)
$id: "http://devicetree.org/schemas/sound/alif,alif-pcm.yaml#"
$schema: "http://devicetree.org/meta-schemas/core.yaml#"

title: Alif Ensemble PCM Audio CODEC

description: |
  Binding for the Alif Ensemble PCM audio CODEC.

maintainers:
  - Hemanth Kumar <hemanth@alifsemi.com>

properties:
  compatible:
    const: alif,alif-pcm

  pinctrl-names:
    items:
      - const: default
    description: Should contain only one value - "default".

  pinctrl-0:
    description: Should specify pin control groups used for this controller.

  reg:
    maxItems: 1
    description: Base address and size of the IP core instance.

  interrupts:
    minItems: 1
    description: List of interrupt numbers.

  clock-names:
    items:
      - const: pclk
    description: List of input clocks. Must contain "pclk".

  clocks:
    maxItems: 1
    description: Input clock specifier. Refer to common clock bindings.

  status:
    description: Status property to enable/disable the device.

required:
  - compatible
  - pinctrl-names
  - pinctrl-0
  - reg
  - interrupt-parent
  - interrupts
  - clock-names
  - clocks

additionalProperties: false

examples:
  - |
    pcm: pcm@4902D000 {
      compatible = "alif,alif-pcm";
      pinctrl-names = "default";
      pinctrl-0 = <&pinctrl_pcm0>;
      reg = <0x4902D000 0x1000>;
      clocks = <&syst_pclk 0>;
      clock-names = "pclk";
      interrupt-parent = <&gic>;
      interrupts = <0 134 IRQ_TYPE_LEVEL_HIGH>;
      status = PCM_STATUS;
    };
```

## Documentation/devicetree/bindings/sound/invensense,t5848.yaml
```yaml
# SPDX-License-Identifier: GPL-2.0-only OR BSD-2-Clause
%YAML 1.2
---
$id: http://devicetree.org/schemas/sound/invensense,t5848.yaml#
$schema: http://devicetree.org/meta-schemas/core.yaml#

title: InvenSense T5848 Mems Mic

description: |
  The T5848 is a multi-mode, low noise digital MEMS microphone
  There are no software configuration options for this device,
  indeed, the only host connection is the I2S interface.

  The slave serial data port’s format is I²S, two’s complement.
  There must be 64 SCK cycles in each stereo WS frame when operating in
  High Quality Mode and 48 SCK cycles per frame in Low Power Mode.

maintainers:
  - Hemanth.Kumar<hemanth@alifsemi.com>

properties:
  compatible:
    enum:
      - invensense,t5848

  '#sound-dai-cells':
    const: 0

required:
  - compatible

additionalProperties: false

examples:
  - |
    t5848: acodec {
    	#sound-dai-cells = <0>;
    	compatible = "invensense,t5848";
    };

    /* Example of a "simple-audio-card" */
    sound-memsmic {
    	compatible = "simple-audio-card";
    	simple-audio-card,name = "mems-mic";
    	simple-audio-card,format = "i2s";
    	simple-audio-card,frame-master = <&cpudai_1>;
    	simple-audio-card,bitclock-master = <&cpudai_1>;

    	cpudai_1: simple-audio-card,cpu {
    		sound-dai = <&i2s3>;
    	};

    	mcodec: simple-audio-card,codec {
    		sound-dai = <&t5848>;
    	};
    };
```

## arch/arm/configs/devkit_e7_defconfig
```kconfig
# CONFIG_LOCALVERSION_AUTO is not set
# CONFIG_CROSS_MEMORY_ATTACH is not set
CONFIG_PREEMPT=y
CONFIG_LOG_BUF_SHIFT=13
# CONFIG_INITRAMFS_PRESERVE_MTIME is not set
CONFIG_CC_OPTIMIZE_FOR_SIZE=y
CONFIG_EXPERT=y
# CONFIG_ARM_PATCH_PHYS_VIRT is not set
CONFIG_PHYS_OFFSET=0x2000000
CONFIG_ARM_MULTI_ARMV8A=y
CONFIG_ARCH_ENSEMBLE=y
CONFIG_SMP=y
# CONFIG_SMP_ON_UP is not set
CONFIG_HAVE_ARM_ARCH_TIMER=y
CONFIG_NR_CPUS=2
CONFIG_ARM_PSCI=y
CONFIG_THUMB2_KERNEL=y
# CONFIG_ARM_PATCH_IDIV is not set
# CONFIG_ARM_PAN is not set
# CONFIG_ATAGS is not set
CONFIG_CMDLINE="console=ttyS1"
CONFIG_XIP_KERNEL=y
CONFIG_XIP_PHYS_ADDR=0x80020000
CONFIG_VFP=y
CONFIG_NEON=y
CONFIG_KERNEL_MODE_NEON=y
# CONFIG_SUSPEND is not set
# CONFIG_SECCOMP is not set
# CONFIG_STACKPROTECTOR is not set
CONFIG_COMPAT_32BIT_TIME=y
# CONFIG_VMAP_STACK is not set
# CONFIG_GCC_PLUGINS is not set
# CONFIG_CORE_DUMP_DEFAULT_ELF_HEADERS is not set
CONFIG_BINFMT_SCRIPT=y
# CONFIG_SWAP is not set
# CONFIG_COMPAT_BRK is not set
CONFIG_SPARSEMEM_MANUAL=y
# CONFIG_BOUNCE is not set
CONFIG_DEVTMPFS=y
CONFIG_MTD=y
CONFIG_MTD_CMDLINE_PARTS=y
CONFIG_MTD_BLOCK=y
CONFIG_MTD_ROM=y
CONFIG_MTD_PHYSMAP=y
CONFIG_MTD_PHYSMAP_COMPAT=y
CONFIG_MTD_PHYSMAP_START=0x80300000
CONFIG_MTD_PHYSMAP_LEN=0x200000
CONFIG_MTD_PHYSMAP_BANKWIDTH=4
CONFIG_MTD_PHYSMAP_OF=y
CONFIG_MTD_PLATRAM=y
# CONFIG_BLK_DEV is not set
CONFIG_INPUT_FF_MEMLESS=y
# CONFIG_INPUT_KEYBOARD is not set
# CONFIG_INPUT_MOUSE is not set
# CONFIG_LEGACY_PTYS is not set
CONFIG_SERIAL_8250=y
CONFIG_SERIAL_8250_CONSOLE=y
CONFIG_SERIAL_8250_NR_UARTS=8
CONFIG_SERIAL_8250_RUNTIME_UARTS=8
CONFIG_SERIAL_8250_DW=y
CONFIG_GPIO_DWAPB=y
# CONFIG_HWMON is not set
# CONFIG_HID_SUPPORT is not set
# CONFIG_USB_SUPPORT is not set
# CONFIG_VIRTIO_MENU is not set
# CONFIG_VHOST_MENU is not set
# CONFIG_IOMMU_SUPPORT is not set
# CONFIG_NVMEM is not set
# CONFIG_DNOTIFY is not set
# CONFIG_INOTIFY_USER is not set
# CONFIG_PROC_SYSCTL is not set
# CONFIG_PROC_PAGE_MONITOR is not set
CONFIG_TMPFS=y
CONFIG_CRAMFS=y
CONFIG_CRAMFS_MTD=y
CONFIG_LSM="lockdown,yama,loadpin,safesetid,integrity"
# CONFIG_SYMBOLIC_ERRNAME is not set
# CONFIG_DEBUG_BUGVERBOSE is not set
# CONFIG_DEBUG_MISC is not set
# CONFIG_FTRACE is not set
# CONFIG_RUNTIME_TESTING_MENU is not set
```

## arch/arm/mach-ensemble/Kconfig
```kconfig
# SPDX-License-Identifier: GPL-2.0-only
menuconfig ARCH_ENSEMBLE
	bool "Alif Ensemble SoCs"
	select ARCH_SPARSEMEM_ENABLE
	select NEED_MACH_MEMORY_H
	select HIGHMEM
	select PINCTRL
	select PINCTRL_ENSEMBLE
	select GPIOLIB
	select ARM_AMBA
	select ARM_GIC
	select ARM_GLOBAL_TIMER
	select NO_IOPORT_MAP
	select AUTO_ZRELADDR
	select TIMER_OF
	select COMMON_CLK
	select GENERIC_CLOCKEVENTS
	select MULTI_IRQ_HANDLER
	select SPARSE_IRQ
	select USE_OF
	select ENSEMBLE_SD_RESET
	help
	  This option enables support for tiny linux based systems using Cortex
	  A32 processor.
```

## drivers/dma/alif/Kconfig
```kconfig
config ALIF_EVENT_ROUTER
    tristate "ALIF Event Router DMA Controller"
    depends on ARCH_ENSEMBLE && DMA_ENGINE
    default y if ARCH_ENSEMBLE
    help
      This enables support for the ALIF Event Router DMA controller which acts
      as a 4:1 multiplexer between peripherals and the DMA controller.

      Each of the 32 DMA channels can be connected to one of 4 peripherals
      controlled by this event router.

      Say Y here if you are using an ALIF SoC with this hardware block.
```
